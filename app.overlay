/ {
    buttons {
        compatible = "gpio-keys";

        button0: button_0 {
            gpios = <&gpio0 4 (GPIO_PULL_UP | GPIO_ACTIVE_LOW)>;
            label = "User Button";
        };
    };
};